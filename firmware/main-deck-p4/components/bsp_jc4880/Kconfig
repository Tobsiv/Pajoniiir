## firmware/main-deck-p4/components/bsp_jc4880/Kconfig
```kconfig
menu "Pajoniiir JC4880 BSP"

config BSP_PCM5102A_MAIN_OUT
    bool "Enable PCM5102A main I2S output"
    default n
    help
        Enable the second I2S TX channel for the external PCM5102A MAIN OUT DAC.
        Keep disabled until GPIO50/GPIO52/GPIO51 are bench-verified on JP1.

config BSP_ES8311_MONITOR
    bool "Enable ES8311 onboard monitor codec (dev boards only)"
    default y
    help
        Bring up the ES8311 codec on I2S unit 0 for the onboard monitor
        speaker/headphones path. The production board has no ES8311 — disable
        this (product config: PCM5102A MAIN on I2S unit 1, a second PCM5102A
        for CUE/headphones on I2S unit 0, GPIO32/34/35).

endmenu
```

## firmware/main-deck-p4/components/midi_uart_link/Kconfig
```kconfig
menu "Serial MIDI controller link"

config MIDI_UART_LINK_ENABLED
    bool "Receive controller MIDI over UART"
    default y
    help
        Starts a UART receiver that parses a raw MIDI 1.0 byte stream from an
        external controller MCU and injects it into the controller runtime
        (controller_runtime_handle_midi). Replaces the retired ESP32-S3
        control-link bridge for the standalone product.

config MIDI_UART_LINK_PORT
    int "UART port number"
    default 1
    range 1 2
    depends on MIDI_UART_LINK_ENABLED
    help
        UART peripheral index. 0 is the console; 1 uses the free JP1 pins.

config MIDI_UART_LINK_RX_GPIO
    int "RX GPIO (controller TX -> P4)"
    default 28
    depends on MIDI_UART_LINK_ENABLED

config MIDI_UART_LINK_TX_GPIO
    int "TX GPIO (P4 -> controller, LED feedback)"
    default 29
    depends on MIDI_UART_LINK_ENABLED

config MIDI_UART_LINK_BAUD
    int "Baud rate"
    default 19200
    depends on MIDI_UART_LINK_ENABLED
    help
        19200 8N1 is the first bring-up target (ATmega32U4 @ 8 MHz has ~0.16%
        error there). Standard serial-MIDI is 31250; both are supported.

endmenu
```
